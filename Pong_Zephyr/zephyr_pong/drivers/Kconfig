## Pong_Zephyr/zephyr_pong/drivers/matrix/Kconfig
```kconfig
# Copyright (c) 2021 Nordic Semiconductor ASA
# SPDX-License-Identifier: Apache-2.0

config RN_LED_MATRIX
	bool "Railnova LED matrix driver"
	depends on GPIO
	help
	  Enable Railnova LED matrix driver.
```

## Pong_Zephyr/zephyr_pong/dts/bindings/zephyr,railnova-led-matrix.yaml
```yaml
#
# Copyright Railnova 2022
# Authors : Bultot Geoffrey & Lea Vielfaure
# Railnova Proprietary Licence

description: Generic LED matrix
include: base.yaml
compatible: "zephyr,railnova-led-matrix"
properties:
    label:
      required: true
    rowgpios:
      type: phandle-array
      required: true
      description: |
        Array of GPIOs to be used as rows of the matrix.
    colgpios:
      type: phandle-array
      required: true
      description: |
        Array of GPIOs to be used as columns of the matrix.
```
